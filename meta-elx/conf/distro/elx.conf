## meta-elx/conf/distro/elx.conf
```bitbake
require conf/distro/poky.conf

DISTRO = "elx" 
DISTRO_NAME = "Erni Linux for Summerevent"
DISTRO_VERSION = "0.1"


PACKAGE_CLASSES = "package_rpm"
EXTRA_IMAGE_FEATURES = "debug-tweaks"
```

## meta-elx/conf/layer.conf
```bitbake
# We have a conf and classes directory, add to BBPATH
BBPATH .= ":${LAYERDIR}"

# We have recipes-* directories, add to BBFILES
BBFILES += "${LAYERDIR}/recipes-*/*/*.bb \
            ${LAYERDIR}/recipes-*/*/*.bbappend"

BBFILE_COLLECTIONS += "meta-elx"
BBFILE_PATTERN_meta-elx = "^${LAYERDIR}/"
BBFILE_PRIORITY_meta-elx = "6"

LAYERDEPENDS_meta-elx = "core"
LAYERSERIES_COMPAT_meta-elx = "dunfell"
```
